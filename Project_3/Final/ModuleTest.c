// ModuleTest.c
// Runs on TM4C123
// Group number: 15
// Group members: Natasha Kho, Justin Narciso

 // ******* Required Hardware I/O connections*******************
// Slide/rotary pot pin 1 connected to ground
// Slide/rotary pot pin 2 connected to Ain8 (PE5)
// Slide/rotary pot pin 3 connected to pne side of the 1k resistor
// other side of the 1k resistor is connected to +3.3V 

#include "ADC1SS3.h"
#include "PLL.h"
#include <stdint.h>
#include <stdio.h>
#include "Nokia5110.h"
#include "Sound.h"
#include "switch.h"
#include "Systick.h"
#include "DAC.h"
#include "Timer1A.h"
#include "tm4c123gh6pm.h"

//#define ADC_TEST
//#define LCD_TEST
//#define SOUND_TEST

extern void EnableInterrupts(void);
extern void DisableInterrupts(void);
void Delay(uint32_t ulCount);

const uint8_t SmallEnemy30PointA[] = {
 0x42, 0x4D, 0xC6, 0x00, 0x00, 0x00, 0x00, 0x00, 0x00, 0x00, 0x76, 0x00, 0x00, 0x00, 0x28, 0x00, 0x00, 0x00, 0x10, 0x00, 0x00, 0x00, 0x0A, 0x00, 0x00, 0x00, 0x01, 0x00, 0x04, 0x00, 0x00, 0x00,
 0x00, 0x00, 0x50, 0x00, 0x00, 0x00, 0x00, 0x00, 0x00, 0x00, 0x00, 0x00, 0x00, 0x00, 0x00, 0x00, 0x00, 0x00, 0x00, 0x00, 0x00, 0x00, 0x00, 0x00, 0x00, 0x00, 0x00, 0x00, 0x80, 0x00, 0x00, 0x80,
 0x00, 0x00, 0x00, 0x80, 0x80, 0x00, 0x80, 0x00, 0x00, 0x00, 0x80, 0x00, 0x80, 0x00, 0x80, 0x80, 0x00, 0x00, 0x80, 0x80, 0x80, 0x00, 0xC0, 0xC0, 0xC0, 0x00, 0x00, 0x00, 0xFF, 0x00, 0x00, 0xFF,
 0x00, 0x00, 0x00, 0xFF, 0xFF, 0x00, 0xFF, 0x00, 0x00, 0x00, 0xFF, 0x00, 0xFF, 0x00, 0xFF, 0xFF, 0x00, 0x00, 0xFF, 0xFF, 0xFF, 0x00, 0x00, 0x00, 0x00, 0x00, 0x00, 0x00, 0x00, 0x00, 0x00, 0x00,
 0x0F, 0x00, 0x00, 0xF0, 0x00, 0x00, 0x00, 0x00, 0xF0, 0x00, 0x00, 0x0F, 0x00, 0x00, 0x00, 0x00, 0x0F, 0x0F, 0xF0, 0xF0, 0x00, 0x00, 0x00, 0x00, 0xFF, 0xFF, 0xFF, 0xFF, 0x00, 0x00, 0x00, 0x00,
 0xFF, 0x0F, 0xF0, 0xFF, 0x00, 0x00, 0x00, 0x00, 0x0F, 0xFF, 0xFF, 0xF0, 0x00, 0x00, 0x00, 0x00, 0x00, 0xFF, 0xFF, 0x00, 0x00, 0x00, 0x00, 0x00, 0x00, 0x0F, 0xF0, 0x00, 0x00, 0x00, 0x00, 0x00,
 0x00, 0x00, 0x00, 0x00, 0x00, 0x00, 0xFF};

 

#define MAX_X_AXIS 83  // size of the LCD screen 48x84, X axis range: 0 to 83

void LCD_Test(void);
void Sound_Test(void);
void Delay100ms(uint32_t count);
static unsigned int count12;
 
int main(void){
	DisableInterrupts();
	PLL_Init();             // set system clock to 80 MHz
	#ifdef ADC_TEST
	uint8_t x_axis;
	#endif
  

	#ifdef ADC_TEST
	ADC1SS3_Init();
  #endif
	#ifdef SOUND_TEST
	Sound_Init();
	#endif
	#ifdef LCD_TEST
	Nokia5110_Init();
	count12 = 0;
  #endif
	EnableInterrupts();
	
  while(1){
	#ifdef ADC_TEST
    x_axis = ADCValue_To_X_AXIS(ADC1SS3_In(),MAX_X_AXIS);		
	#endif
	#ifdef LCD_TEST
    LCD_Test();		 
	#endif
	#ifdef LCD_TEST
    //LCD_Test();		
	#endif
	#ifdef SOUND_TEST

		Sound_Test();

	#endif		
    Delay100ms(50);
  }
}

void Delay100ms(uint32_t count){
  uint32_t time;
  while(count>0){
    time = 72724;  // 0.1sec at 16 MHz
		//time = 363620;  // ~0.1sec at 80 MHz

    while(time){
	  	time--;
    }
    count--;
  }
}

#ifdef LCD_TEST

void LCD_Test(void){
  char prompt[]= "Game Over   Nice Try!   Your Score  ";
	int end_score = 2;
	char end_message[73];
	Nokia5110_Clear();
	sprintf(end_message, "%s%d" ,prompt, end_score);
	
	
	Nokia5110_SetCursor(0, 1);
	Nokia5110_OutString(end_message);
}

void Delay(uint32_t ulCount){
  do{
    ulCount--;
	}while(ulCount);
}


#endif

#ifdef SOUND_TEST
void Sound_Test(void){
	LED ^= LED_RED;
	uint8_t i;
	Sound_Shoot();

}
	
#endif



